## firmware/esp32-hid-host-uart/main/Kconfig.projbuild
```kconfig
menu "Bind Bandit (ESP32 Classic-BT Host)"

config JOYCON_HOST_NAME_SUBSTR
    string "Target device name substring"
    default "Joy-Con"
    help
        Substring match against discovered device names.
        For Binbok / third-party controllers you may need to change this
        (e.g. "Binbok", "Pro Controller", etc.).

config JOYCON_HOST_DISCOVERY_SECONDS
    int "Inquiry scan duration (seconds)"
    range 1 60
    default 10
    help
        How long each Bluetooth inquiry scan should run.

config JOYCON_HOST_LOG_REPORTS
    bool "Log HID input reports (on change)"
    default y
    help
        When enabled, logs input report bytes when they change.
        This is the evidence-first workflow for implementing a correct mapper.

config JOYCON_HOST_UART_DEBUG_REPORTS
    bool "Forward raw HID reports over UART (debug frames)"
    default n
    help
        When enabled, raw HID reports are also forwarded over the existing UART
        framing (length > 1). The ESP32-S3 receiver ignores these frames.
        Use this only for offline capture with a USB-UART dongle.

config JOYCON_HOST_UART_DEBUG_MAX_BYTES
    int "Max HID report bytes to forward"
    range 8 200
    default 48
    depends on JOYCON_HOST_UART_DEBUG_REPORTS
    help
        HID reports can be long; forward only the first N bytes.

config JOYCON_HOST_TRY_NINTENDO_0X30
    bool "Try parse Nintendo-style 0x30 reports (candidate, optional)"
    default n
    help
        When enabled, the mapper will attempt to parse reports that match a common
        Nintendo-style signature (report_id=0x30). This is useful as a hint when
        you are capturing evidence and want higher-level fields (buttons/sticks)
        printed for validation.

        It stays conservative:
        - It only activates when the signature matches.
        - It does not guess other layouts.

config JOYCON_HOST_NINTENDO_0X30_EMIT_KEYS
    bool "Emit key events from parsed 0x30 reports (advanced)"
    default n
    depends on JOYCON_HOST_TRY_NINTENDO_0X30
    help
        When enabled, the mapper will emit KEY_ID_* events from parsed stick data.
        Keep this OFF until you've verified that the parsed fields match your
        actual controller by comparing with raw report bytes.

config JOYCON_HOST_AUTO_RECONNECT
    bool "Auto-reconnect on BT disconnect"
    default y
    help
        When enabled, the ESP32 will automatically attempt to re-connect to the
        last known controller BDA after a disconnect. Uses exponential backoff
        (2s, 4s, 8s) for up to 3 retries before falling back to discovery.

config JOYCON_HOST_AUTO_RECONNECT_MAX_RETRIES
    int "Max auto-reconnect retries"
    range 1 10
    default 3
    depends on JOYCON_HOST_AUTO_RECONNECT
    help
        Number of reconnect attempts before giving up and restarting discovery.

config JOYCON_HOST_SETUP_TIMEOUT_MS
    int "Setup FSM step timeout (ms)"
    range 500 10000
    default 1500
    help
        How long each setup FSM step waits for a response before retrying
        or advancing. Lower values speed up connection but may cause skipped
        steps on slow controllers.

config JOYCON_HOST_SETUP_MAX_RETRIES
    int "Setup FSM max retries per step"
    range 0 10
    default 2
    help
        Number of times to retry each setup FSM step on timeout before
        advancing to the next step.  0 = no retries (advance immediately).

config JOYCON_HOST_SETUP_CONNECT_DELAY_MS
    int "Post-connection delay before FSM starts (ms)"
    range 0 5000
    default 500
    help
        Delay after a BT HID connection opens before the setup FSM sends
        its first subcommand.  This lets the BT link stabilise and
        complete power-mode negotiations (e.g. sniff mode).  Set to 0 to
        disable the delay.

config BIND_BANDIT_INSTALLER_S3_BOOT_GPIO
    int "Installer S3 BOOT pin (Nano B1 / GPIO0)"
    range 0 39
    default 21
    help
        ESP32 GPIO used to drive the Nano ESP32-S3 boot strap pin during the
        browser-based first-install flow. Wire this to Nano B1 / GPIO0.

config BIND_BANDIT_INSTALLER_S3_RESET_GPIO
    int "Installer S3 RESET pin"
    range 0 39
    default 22
    help
        ESP32 GPIO used to pulse the Nano ESP32-S3 RESET pin during the
        browser-based first-install flow.

config JOYCON_HOST_MOTION_SHAKE_THRESHOLD
    int "Shake gesture accel threshold"
    range 2000 30000
    default 12000
    depends on JOYCON_HOST_NINTENDO_0X30_EMIT_KEYS
    help
        Acceleration magnitude (raw int16 units) above which a "shake"
        gesture is detected. Higher = less sensitive.

config BIND_BANDIT_BUZZER_ENABLED
    bool "Enable piezo buzzer audio feedback"
    default y
    help
        Drive a passive piezo buzzer via LEDC PWM to provide audible
        feedback for BT connect/disconnect, discovery start, setup
        complete, and error conditions.  Disable to save one GPIO and
        a small amount of flash.

config BIND_BANDIT_BUZZER_GPIO
    int "Buzzer GPIO pin"
    range 0 39
    default 25
    depends on BIND_BANDIT_BUZZER_ENABLED
    help
        GPIO pin connected to the passive piezo buzzer.  One leg of the
        buzzer goes to this pin, the other to GND.  Default GPIO 25 is
        free on most ESP32 dev boards.

config JOYCON_HOST_MOTION_TILT_THRESHOLD
    int "Tilt gesture accel threshold"
    range 500 10000
    default 3000
    depends on JOYCON_HOST_NINTENDO_0X30_EMIT_KEYS
    help
        Per-axis acceleration threshold for sustained tilt detection.
        Higher = less sensitive.

config JOYCON_HOST_MOTION_FLICK_THRESHOLD
    int "Flick gesture gyro threshold"
    range 2000 30000
    default 10000
    depends on JOYCON_HOST_NINTENDO_0X30_EMIT_KEYS
    help
        Gyro magnitude threshold for quick-twist "flick" gestures.
        Higher = less sensitive.

config JOYCON_HOST_MOTION_COOLDOWN_MS
    int "Motion gesture cooldown (ms)"
    range 50 2000
    default 250
    depends on JOYCON_HOST_NINTENDO_0X30_EMIT_KEYS
    help
        Minimum milliseconds between repeated gesture triggers.
        Prevents rapid-fire gesture events.

endmenu
```

## firmware/esp32s3-usb-kbd/main/Kconfig.projbuild
```kconfig
menu "Bind Bandit (ESP32-S3 USB Keyboard)"

config BRIDGE_UART_PORT
    int "UART port" 
    range 0 2
    default 1
    help
        UART peripheral number used to receive frames from the Joy-Con receiver.

config BRIDGE_UART_BAUD
    int "Bridge UART baud"
    default 921600

config BRIDGE_UART_TX_GPIO
    int "Bridge UART TX GPIO"
    default 6
    help
        GPIO used for UART TX (Nano ESP32 D3 = GPIO6).

config BRIDGE_UART_RX_GPIO
    int "Bridge UART RX GPIO"
    default 5
    help
        GPIO used for UART RX (Nano ESP32 D2 = GPIO5). Connect to Joy-Con receiver TX.

endmenu
```
